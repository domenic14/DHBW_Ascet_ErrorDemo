ASAP2_VERSION 1 41
/begin PROJECT PC_PC_1_ "Generated by ETAS from Project PC_PC_1_"
/begin HEADER "" VERSION "000" PROJECT_NO ASD /end HEADER
/begin MODULE PC_PC_1_ "Generated by ETAS ASCET7 from Project: PC_PC_1_"
/begin IF_DATA E_TARGET
 /begin SOURCE "Task0" 3 /* period */ 10 QP_BLOB 1 /end SOURCE
 /begin TP_BLOB /* programm id */ 883406879 /* target id */ 7 0 2 0 /end TP_BLOB
/end IF_DATA
/begin MOD_PAR "" VERSION "000" ADDR_EPK 0x0 EPK "" SUPPLIER "ETAS GmbH" CUSTOMER "xxx" CUSTOMER_NO "000" USER "xxx" PHONE_NO "000" ECU "PC" CPU_TYPE "PCx86" NO_OF_INTERFACES 1 /end MOD_PAR
/begin MOD_COMMON "Common definitions" BYTE_ORDER MSB_LAST ALIGNMENT_BYTE 1 ALIGNMENT_WORD 2 ALIGNMENT_LONG 4 ALIGNMENT_FLOAT32_IEEE 4 ALIGNMENT_FLOAT64_IEEE 8 /end MOD_COMMON
/begin CHARACTERISTIC myCar.myCar.myVehicle.BrakeMomentum "" CURVE 0x0 STANDARD_CURVE_R32R32 0.0 esdl_ident_a -3.4028234663852886E+38 3.4028234663852886E+38
 /begin AXIS_DESCR STD_AXIS NO_INPUT_QUANTITY esdl_ident 6 -3.4028234663852886E+38 3.4028234663852886E+38 /end AXIS_DESCR
/end CHARACTERISTIC
/begin CHARACTERISTIC myCar.myCar.myVehicle.EngineMomentum "" MAP 0x0 STANDARD_MAP_R32R32R32 0.0 esdl_ident_a -3.4028234663852886E+38 3.4028234663852886E+38
 /begin AXIS_DESCR STD_AXIS NO_INPUT_QUANTITY esdl_ident 6 -3.4028234663852886E+38 3.4028234663852886E+38 /end AXIS_DESCR
 /begin AXIS_DESCR STD_AXIS myCar.myCar.myVehicle.v esdl_ident_kmh 6 -3.4028234663852886E+38 3.4028234663852886E+38 /end AXIS_DESCR
/end CHARACTERISTIC
/begin CHARACTERISTIC myCar.myCar.myVehicle.AirFriction "" CURVE 0x0 STANDARD_CURVE_R32R32 0.0 esdl_ident_a -3.4028234663852886E+38 3.4028234663852886E+38
 /begin AXIS_DESCR STD_AXIS myCar.myCar.myVehicle.v esdl_ident_kmh 6 -3.4028234663852886E+38 3.4028234663852886E+38 /end AXIS_DESCR
/end CHARACTERISTIC
/begin CHARACTERISTIC myCar.myCar.myVehicle.Landscape "" CURVE 0x0 STANDARD_CURVE_R32R32 0.0 esdl_ident_m -3.4028234663852886E+38 3.4028234663852886E+38
 /begin AXIS_DESCR STD_AXIS myCar.myCar.myVehicle.dist esdl_ident_m 128 -3.4028234663852886E+38 3.4028234663852886E+38 /end AXIS_DESCR
/end CHARACTERISTIC
/begin MEASUREMENT myCar.myCar.myVehicle.h "" FLOAT32_IEEE esdl_ident_m 1 100.0 -3.4028234663852886E+38 3.4028234663852886E+38 ECU_ADDRESS 0x0 /end MEASUREMENT
/begin MEASUREMENT myCar.myCar.myVehicle.dh "" FLOAT32_IEEE esdl_ident_m 1 100.0 -3.4028234663852886E+38 3.4028234663852886E+38 ECU_ADDRESS 0x0 /end MEASUREMENT
/begin MEASUREMENT myCar.myCar.myVehicle.ds "" FLOAT32_IEEE esdl_ident_m 1 100.0 -3.4028234663852886E+38 3.4028234663852886E+38 ECU_ADDRESS 0x0 /end MEASUREMENT
/begin MEASUREMENT myCar.myCar.myVehicle.momentum "" FLOAT32_IEEE esdl_ident_a 1 100.0 -3.4028234663852886E+38 3.4028234663852886E+38 ECU_ADDRESS 0x0 /end MEASUREMENT
/begin MEASUREMENT myCar.myCar.myVehicle.dist "" FLOAT32_IEEE esdl_ident_m 1 100.0 -3.4028234663852886E+38 3.4028234663852886E+38 ECU_ADDRESS 0x0 /end MEASUREMENT
/begin CHARACTERISTIC myCar.myCar.myVehicle.TrackSize "" VALUE 0x0 STANDARD_VALUE_R32 0.0 esdl_ident_m -3.4028234663852886E+38 3.4028234663852886E+38 /end CHARACTERISTIC
/begin MEASUREMENT myCar.myCar.myVehicle.v "" FLOAT32_IEEE esdl_ident_kmh 1 100.0 -3.4028234663852886E+38 3.4028234663852886E+38 ECU_ADDRESS 0x0 /end MEASUREMENT
/begin MEASUREMENT myCar.myCar.myVehicle.MyTurn_instance.x "" FLOAT32_IEEE esdl_ident_m 1 100.0 -3.4028234663852886E+38 3.4028234663852886E+38 ECU_ADDRESS 0x0 /end MEASUREMENT
/begin MEASUREMENT myCar.myCar.myVehicle.MyTurn_instance.y "" FLOAT32_IEEE esdl_ident_m 1 100.0 -3.4028234663852886E+38 3.4028234663852886E+38 ECU_ADDRESS 0x0 /end MEASUREMENT
/begin MEASUREMENT myCar.myCar.myVehicle.MyTurn_instance.bearing "" FLOAT32_IEEE esdl_ident 1 100.0 -3.4028234663852886E+38 3.4028234663852886E+38 ECU_ADDRESS 0x0 /end MEASUREMENT
/begin CHARACTERISTIC myCar.myCar.myVehicle.MyTurn_instance.D "" VALUE 0x0 STANDARD_VALUE_R32 0.0 esdl_ident_m -3.4028234663852886E+38 3.4028234663852886E+38 /end CHARACTERISTIC
/begin MEASUREMENT myCar.myCar.myVehicle.MyTurn_instance.dpi "" FLOAT32_IEEE esdl_ident 1 100.0 -3.4028234663852886E+38 3.4028234663852886E+38 ECU_ADDRESS 0x0 /end MEASUREMENT
/begin MEASUREMENT myCar.myCar.myVehicle.MyTurn_instance.pi "" FLOAT32_IEEE esdl_ident 1 100.0 -3.4028234663852886E+38 3.4028234663852886E+38 ECU_ADDRESS 0x0 /end MEASUREMENT
/begin MEASUREMENT myCar.myCar.myVehicle.x "" FLOAT32_IEEE esdl_ident_m 1 100.0 -3.4028234663852886E+38 3.4028234663852886E+38 ECU_ADDRESS 0x0 /end MEASUREMENT
/begin MEASUREMENT myCar.myCar.myVehicle.y "" FLOAT32_IEEE esdl_ident_m 1 100.0 -3.4028234663852886E+38 3.4028234663852886E+38 ECU_ADDRESS 0x0 /end MEASUREMENT
/begin MEASUREMENT myCar.myCar.myVehicle.bearing "" FLOAT32_IEEE esdl_ident 1 100.0 -3.4028234663852886E+38 3.4028234663852886E+38 ECU_ADDRESS 0x0 /end MEASUREMENT
/begin CHARACTERISTIC myCar.myCar.g "" VALUE 0x0 STANDARD_VALUE_R32 0.0 esdl_ident_a -3.4028234663852886E+38 3.4028234663852886E+38 /end CHARACTERISTIC
/begin CHARACTERISTIC myCar.Driver.accButton "" VALUE 0x0 STANDARD_VALUE_U8 0.0 esdl_ident 0 1 BIT_MASK 0x1 /end CHARACTERISTIC
/begin CHARACTERISTIC myCar.Driver.brake "" VALUE 0x0 STANDARD_VALUE_R32 0.0 esdl_ident -3.4028234663852886E+38 3.4028234663852886E+38 /end CHARACTERISTIC
/begin CHARACTERISTIC myCar.Driver.power "" VALUE 0x0 STANDARD_VALUE_R32 0.0 esdl_ident -3.4028234663852886E+38 3.4028234663852886E+38 /end CHARACTERISTIC
/begin CHARACTERISTIC myCar.Driver.decreaseSpeed "" VALUE 0x0 STANDARD_VALUE_U8 0.0 esdl_ident 0 1 BIT_MASK 0x1 /end CHARACTERISTIC
/begin CHARACTERISTIC myCar.Driver.increaseSpeed "" VALUE 0x0 STANDARD_VALUE_U8 0.0 esdl_ident 0 1 BIT_MASK 0x1 /end CHARACTERISTIC
/begin CHARACTERISTIC myCar.Driver.ignition "" VALUE 0x0 STANDARD_VALUE_U8 0.0 esdl_ident 0 1 BIT_MASK 0x1 /end CHARACTERISTIC
/begin CHARACTERISTIC myCar.Driver.curve_real_instance "" CURVE 0x0 STANDARD_CURVE_R32R32 0.0 esdl_ident -3.4028234663852886E+38 3.4028234663852886E+38
 /begin AXIS_DESCR STD_AXIS NO_INPUT_QUANTITY esdl_ident 3 -3.4028234663852886E+38 3.4028234663852886E+38 /end AXIS_DESCR
/end CHARACTERISTIC
/begin MEASUREMENT myCar.Control.StateMachine_instance_2.sm "" UBYTE esdl_myCar_StateMachineStatemachineStates 1 100.0 0 3 ECU_ADDRESS 0x0 /end MEASUREMENT
/begin MEASUREMENT myCar.Control.StateMachine_instance_2.current_v "" FLOAT32_IEEE esdl_ident_kmh 1 100.0 -3.4028234663852886E+38 3.4028234663852886E+38 ECU_ADDRESS 0x0 /end MEASUREMENT
/begin MEASUREMENT myCar.Control.StateMachine_instance_2.increase_speed "" UBYTE esdl_ident 1 100.0 0 1 ECU_ADDRESS 0x0 BIT_MASK 0x1 /end MEASUREMENT
/begin MEASUREMENT myCar.Control.StateMachine_instance_2.decrease_speed "" UBYTE esdl_ident 1 100.0 0 1 ECU_ADDRESS 0x0 BIT_MASK 0x1 /end MEASUREMENT
/begin MEASUREMENT myCar.Control.StateMachine_instance_2.d_brake "" FLOAT32_IEEE esdl_ident 1 100.0 -3.4028234663852886E+38 3.4028234663852886E+38 ECU_ADDRESS 0x0 /end MEASUREMENT
/begin MEASUREMENT myCar.Control.StateMachine_instance_2.acc_state "" UBYTE esdl_ident 1 100.0 0 1 ECU_ADDRESS 0x0 BIT_MASK 0x1 /end MEASUREMENT
/begin MEASUREMENT myCar.Control.StateMachine_instance_2.acc_button "" UBYTE esdl_ident 1 100.0 0 1 ECU_ADDRESS 0x0 BIT_MASK 0x1 /end MEASUREMENT
/begin MEASUREMENT myCar.Control.StateMachine_instance_2.ign_on "" UBYTE esdl_ident 1 100.0 0 1 ECU_ADDRESS 0x0 BIT_MASK 0x1 /end MEASUREMENT
/begin CHARACTERISTIC tests.Test_Brake.execute_brake_test "" VALUE 0x0 STANDARD_VALUE_U8 0.0 esdl_ident 0 1 BIT_MASK 0x1 /end CHARACTERISTIC
/begin MEASUREMENT tests.Test_Brake.accelerateStopWatch.timeCounter "" FLOAT32_IEEE esdl_ident 1 100.0 -3.4028234663852886E+38 3.4028234663852886E+38 ECU_ADDRESS 0x0 /end MEASUREMENT
/begin MEASUREMENT tests.Test_Brake.EdgeRising_instance.buffer "" UBYTE esdl_ident 1 100.0 0 1 ECU_ADDRESS 0x0 BIT_MASK 0x1 /end MEASUREMENT
/begin MEASUREMENT tests.Test_Brake.EdgeRising_instance.oldSignal "" UBYTE esdl_ident 1 100.0 0 1 ECU_ADDRESS 0x0 BIT_MASK 0x1 /end MEASUREMENT
/begin MEASUREMENT tests.Test_Brake.accOnStopwatch.timeCounter "" FLOAT32_IEEE esdl_ident 1 100.0 -3.4028234663852886E+38 3.4028234663852886E+38 ECU_ADDRESS 0x0 /end MEASUREMENT
/begin MEASUREMENT tests.Test_Brake.test_succeeded "" UBYTE esdl_ident 1 100.0 0 1 ECU_ADDRESS 0x0 BIT_MASK 0x1 /end MEASUREMENT
/begin MEASUREMENT tests.Test_Brake.EdgeRising_instance_2.buffer "" UBYTE esdl_ident 1 100.0 0 1 ECU_ADDRESS 0x0 BIT_MASK 0x1 /end MEASUREMENT
/begin MEASUREMENT tests.Test_Brake.EdgeRising_instance_2.oldSignal "" UBYTE esdl_ident 1 100.0 0 1 ECU_ADDRESS 0x0 BIT_MASK 0x1 /end MEASUREMENT
/begin MEASUREMENT tests.Test_Brake.EdgeRising_instance_3.buffer "" UBYTE esdl_ident 1 100.0 0 1 ECU_ADDRESS 0x0 BIT_MASK 0x1 /end MEASUREMENT
/begin MEASUREMENT tests.Test_Brake.EdgeRising_instance_3.oldSignal "" UBYTE esdl_ident 1 100.0 0 1 ECU_ADDRESS 0x0 BIT_MASK 0x1 /end MEASUREMENT
/begin MEASUREMENT resources.CarMessages.currentVehicleSpeed "" FLOAT32_IEEE esdl_ident_km2fh 1 100.0 0.0 200.0 ECU_ADDRESS 0x0 /end MEASUREMENT
/begin MEASUREMENT resources.CarMessages.v_power "" FLOAT32_IEEE esdl_ident 1 100.0 -3.4028234663852886E+38 3.4028234663852886E+38 ECU_ADDRESS 0x0 /end MEASUREMENT
/begin MEASUREMENT resources.CarMessages.v_brake "" FLOAT32_IEEE esdl_ident 1 100.0 -3.4028234663852886E+38 3.4028234663852886E+38 ECU_ADDRESS 0x0 /end MEASUREMENT
/begin MEASUREMENT resources.CarMessages.steering "" FLOAT32_IEEE esdl_ident 1 100.0 -3.4028234663852886E+38 3.4028234663852886E+38 ECU_ADDRESS 0x0 /end MEASUREMENT
/begin MEASUREMENT resources.CarMessages.bearing "" FLOAT32_IEEE esdl_ident 1 100.0 -3.4028234663852886E+38 3.4028234663852886E+38 ECU_ADDRESS 0x0 /end MEASUREMENT
/begin MEASUREMENT resources.CarMessages.x "" FLOAT32_IEEE esdl_ident_m 1 100.0 -3.4028234663852886E+38 3.4028234663852886E+38 ECU_ADDRESS 0x0 /end MEASUREMENT
/begin MEASUREMENT resources.CarMessages.y "" FLOAT32_IEEE esdl_ident_m 1 100.0 -3.4028234663852886E+38 3.4028234663852886E+38 ECU_ADDRESS 0x0 /end MEASUREMENT
/begin MEASUREMENT resources.CarMessages.time "" FLOAT32_IEEE esdl_ident_s 1 100.0 -3.4028234663852886E+38 3.4028234663852886E+38 ECU_ADDRESS 0x0 /end MEASUREMENT
/begin MEASUREMENT resources.DriverMessages.d_brake "" FLOAT32_IEEE esdl_ident 1 100.0 -3.4028234663852886E+38 3.4028234663852886E+38 ECU_ADDRESS 0x0 /end MEASUREMENT
/begin MEASUREMENT resources.DriverMessages.d_power "" FLOAT32_IEEE esdl_ident 1 100.0 -3.4028234663852886E+38 3.4028234663852886E+38 ECU_ADDRESS 0x0 /end MEASUREMENT
/begin MEASUREMENT resources.DriverMessages.accButton "" UBYTE esdl_ident 1 100.0 0 1 ECU_ADDRESS 0x0 BIT_MASK 0x1 /end MEASUREMENT
/begin MEASUREMENT resources.DriverMessages.increaseSpeed "" UBYTE esdl_ident 1 100.0 0 1 ECU_ADDRESS 0x0 BIT_MASK 0x1 /end MEASUREMENT
/begin MEASUREMENT resources.DriverMessages.decreaseSpeed "" UBYTE esdl_ident 1 100.0 0 1 ECU_ADDRESS 0x0 BIT_MASK 0x1 /end MEASUREMENT
/begin MEASUREMENT resources.DriverMessages.acc_state "" UBYTE esdl_ident 1 100.0 0 1 ECU_ADDRESS 0x0 BIT_MASK 0x1 /end MEASUREMENT
/begin MEASUREMENT resources.DriverMessages.selected_v "" FLOAT32_IEEE esdl_ident_kmh 1 100.0 -3.4028234663852886E+38 3.4028234663852886E+38 ECU_ADDRESS 0x0 /end MEASUREMENT
/begin MEASUREMENT resources.DriverMessages.ignition "" UBYTE esdl_ident 1 100.0 0 1 ECU_ADDRESS 0x0 BIT_MASK 0x1 /end MEASUREMENT
/begin COMPU_METHOD esdl_ident "" RAT_FUNC "%12.4" "" COEFFS 0 1 0 0 0 1 /end COMPU_METHOD
/begin COMPU_METHOD esdl_ident_a "" RAT_FUNC "%12.4" "a" COEFFS 0 1 0 0 0 1 /end COMPU_METHOD
/begin COMPU_METHOD esdl_ident_km2fh "" RAT_FUNC "%12.4" "km/h" COEFFS 0 1 0 0 0 1 /end COMPU_METHOD
/begin COMPU_METHOD esdl_ident_kmh "" RAT_FUNC "%12.4" "kmh" COEFFS 0 1 0 0 0 1 /end COMPU_METHOD
/begin COMPU_METHOD esdl_ident_m "" RAT_FUNC "%12.4" "m" COEFFS 0 1 0 0 0 1 /end COMPU_METHOD
/begin COMPU_METHOD esdl_ident_s "" RAT_FUNC "%12.4" "s" COEFFS 0 1 0 0 0 1 /end COMPU_METHOD
/begin COMPU_METHOD esdl_myCar_StateMachineStatemachineStates "" TAB_VERB "%12.4" "" /* compu_tab_ref */ COMPU_TAB_REF esdl_myCar_StateMachineStatemachineStates_vtab /end COMPU_METHOD
/begin COMPU_VTAB esdl_myCar_StateMachineStatemachineStates_vtab "" TAB_VERB /* number value pairs */ 4 0 "off_state" 2 "Copy_1_on_state" 1 "activate_button_pressed" 3 "deactivate_button_pressed" /* default value */ DEFAULT_VALUE "Error" /end COMPU_VTAB
/begin FUNCTION myCar.myCar "" /begin DEF_CHARACTERISTIC myCar.myCar.g /end DEF_CHARACTERISTIC
 /begin IN_MEASUREMENT resources.CarMessages.steering resources.CarMessages.v_brake resources.CarMessages.v_power /end IN_MEASUREMENT
 /begin OUT_MEASUREMENT resources.CarMessages.bearing resources.CarMessages.currentVehicleSpeed resources.CarMessages.x resources.CarMessages.y /end OUT_MEASUREMENT
 /begin SUB_FUNCTION myCar.myCar.myVehicle /end SUB_FUNCTION
/end FUNCTION
/begin FUNCTION myCar.myCar.myVehicle ""
 /begin DEF_CHARACTERISTIC myCar.myCar.myVehicle.BrakeMomentum myCar.myCar.myVehicle.EngineMomentum myCar.myCar.myVehicle.AirFriction myCar.myCar.myVehicle.Landscape myCar.myCar.myVehicle.TrackSize /end DEF_CHARACTERISTIC
 /begin LOC_MEASUREMENT myCar.myCar.myVehicle.bearing myCar.myCar.myVehicle.dh myCar.myCar.myVehicle.dist myCar.myCar.myVehicle.ds myCar.myCar.myVehicle.h myCar.myCar.myVehicle.momentum myCar.myCar.myVehicle.v myCar.myCar.myVehicle.x myCar.myCar.myVehicle.y /end LOC_MEASUREMENT
 /begin SUB_FUNCTION myCar.myCar.myVehicle.MyTurn_instance /end SUB_FUNCTION
/end FUNCTION
/begin FUNCTION myCar.myCar.myVehicle.MyTurn_instance "" /begin DEF_CHARACTERISTIC myCar.myCar.myVehicle.MyTurn_instance.D /end DEF_CHARACTERISTIC
 /begin LOC_MEASUREMENT myCar.myCar.myVehicle.MyTurn_instance.bearing myCar.myCar.myVehicle.MyTurn_instance.dpi myCar.myCar.myVehicle.MyTurn_instance.pi myCar.myCar.myVehicle.MyTurn_instance.x myCar.myCar.myVehicle.MyTurn_instance.y /end LOC_MEASUREMENT
/end FUNCTION
/begin FUNCTION myCar.Driver ""
 /begin DEF_CHARACTERISTIC myCar.Driver.accButton myCar.Driver.brake myCar.Driver.power myCar.Driver.decreaseSpeed myCar.Driver.increaseSpeed myCar.Driver.ignition myCar.Driver.curve_real_instance /end DEF_CHARACTERISTIC
 /begin IN_MEASUREMENT resources.CarMessages.currentVehicleSpeed resources.DriverMessages.acc_state /end IN_MEASUREMENT
 /begin OUT_MEASUREMENT resources.DriverMessages.accButton resources.DriverMessages.d_brake resources.DriverMessages.d_power resources.DriverMessages.decreaseSpeed resources.DriverMessages.ignition resources.DriverMessages.increaseSpeed /end OUT_MEASUREMENT
/end FUNCTION
/begin FUNCTION myCar.Control ""
 /begin IN_MEASUREMENT resources.CarMessages.currentVehicleSpeed resources.DriverMessages.accButton resources.DriverMessages.d_brake resources.DriverMessages.d_power resources.DriverMessages.decreaseSpeed resources.DriverMessages.ignition resources.DriverMessages.increaseSpeed /end IN_MEASUREMENT
 /begin OUT_MEASUREMENT resources.CarMessages.v_brake resources.CarMessages.v_power resources.DriverMessages.acc_state /end OUT_MEASUREMENT
 /begin SUB_FUNCTION myCar.Control.StateMachine_instance_2 /end SUB_FUNCTION
/end FUNCTION
/begin FUNCTION myCar.Control.StateMachine_instance_2 ""
 /begin LOC_MEASUREMENT myCar.Control.StateMachine_instance_2.acc_button myCar.Control.StateMachine_instance_2.acc_state myCar.Control.StateMachine_instance_2.current_v myCar.Control.StateMachine_instance_2.d_brake myCar.Control.StateMachine_instance_2.decrease_speed myCar.Control.StateMachine_instance_2.ign_on myCar.Control.StateMachine_instance_2.increase_speed myCar.Control.StateMachine_instance_2.sm /end LOC_MEASUREMENT
/end FUNCTION
/begin FUNCTION tests.Test_Brake "" /begin DEF_CHARACTERISTIC tests.Test_Brake.execute_brake_test /end DEF_CHARACTERISTIC
 /begin IN_MEASUREMENT resources.CarMessages.v_brake resources.DriverMessages.acc_state /end IN_MEASUREMENT
 /begin OUT_MEASUREMENT resources.DriverMessages.accButton resources.DriverMessages.d_brake resources.DriverMessages.d_power resources.DriverMessages.ignition /end OUT_MEASUREMENT
 /begin LOC_MEASUREMENT tests.Test_Brake.test_succeeded /end LOC_MEASUREMENT
 /begin SUB_FUNCTION tests.Test_Brake.accelerateStopWatch tests.Test_Brake.EdgeRising_instance tests.Test_Brake.accOnStopwatch tests.Test_Brake.EdgeRising_instance_2 tests.Test_Brake.EdgeRising_instance_3 /end SUB_FUNCTION
/end FUNCTION
/begin FUNCTION tests.Test_Brake.accelerateStopWatch "StopWatch increments the time counter by one dT." /begin LOC_MEASUREMENT tests.Test_Brake.accelerateStopWatch.timeCounter /end LOC_MEASUREMENT /end FUNCTION
/begin FUNCTION tests.Test_Brake.EdgeRising_instance "EdgeRising detects a rising edge of the logical input signal."
 /begin LOC_MEASUREMENT tests.Test_Brake.EdgeRising_instance.buffer tests.Test_Brake.EdgeRising_instance.oldSignal /end LOC_MEASUREMENT
/end FUNCTION
/begin FUNCTION tests.Test_Brake.accOnStopwatch "StopWatch increments the time counter by one dT." /begin LOC_MEASUREMENT tests.Test_Brake.accOnStopwatch.timeCounter /end LOC_MEASUREMENT /end FUNCTION
/begin FUNCTION tests.Test_Brake.EdgeRising_instance_2 "EdgeRising detects a rising edge of the logical input signal."
 /begin LOC_MEASUREMENT tests.Test_Brake.EdgeRising_instance_2.buffer tests.Test_Brake.EdgeRising_instance_2.oldSignal /end LOC_MEASUREMENT
/end FUNCTION
/begin FUNCTION tests.Test_Brake.EdgeRising_instance_3 "EdgeRising detects a rising edge of the logical input signal."
 /begin LOC_MEASUREMENT tests.Test_Brake.EdgeRising_instance_3.buffer tests.Test_Brake.EdgeRising_instance_3.oldSignal /end LOC_MEASUREMENT
/end FUNCTION
/begin RECORD_LAYOUT STANDARD_CURVE_R32R32 /* axis size */ NO_AXIS_PTS_X 1 UWORD /* axis */ AXIS_PTS_X 2 FLOAT32_IEEE INDEX_INCR DIRECT FNC_VALUES 3 FLOAT32_IEEE COLUMN_DIR DIRECT /end RECORD_LAYOUT
/begin RECORD_LAYOUT STANDARD_MAP_R32R32R32 /* x axis size */ NO_AXIS_PTS_X 1 UWORD /* y axis size */ NO_AXIS_PTS_Y 2 UWORD /* x axis */ AXIS_PTS_X 3 FLOAT32_IEEE INDEX_INCR DIRECT /* y axis */ AXIS_PTS_Y 4 FLOAT32_IEEE INDEX_INCR DIRECT FNC_VALUES 5 FLOAT32_IEEE COLUMN_DIR DIRECT /end RECORD_LAYOUT
/begin RECORD_LAYOUT STANDARD_VALUE_R32 FNC_VALUES 1 FLOAT32_IEEE COLUMN_DIR DIRECT /end RECORD_LAYOUT
/begin RECORD_LAYOUT STANDARD_VALUE_U8 FNC_VALUES 1 UBYTE COLUMN_DIR DIRECT /end RECORD_LAYOUT
/begin GROUP myCar.Control "" ROOT /begin SUB_GROUP myCar.Control.StateMachine_instance_2 /end SUB_GROUP /end GROUP
/begin GROUP myCar.Control.StateMachine_instance_2 ""
 /begin REF_MEASUREMENT myCar.Control.StateMachine_instance_2.acc_button myCar.Control.StateMachine_instance_2.acc_state myCar.Control.StateMachine_instance_2.current_v myCar.Control.StateMachine_instance_2.d_brake myCar.Control.StateMachine_instance_2.decrease_speed myCar.Control.StateMachine_instance_2.ign_on myCar.Control.StateMachine_instance_2.increase_speed myCar.Control.StateMachine_instance_2.sm /end REF_MEASUREMENT
/end GROUP
/begin GROUP myCar.Driver "" ROOT
 /begin REF_CHARACTERISTIC myCar.Driver.accButton myCar.Driver.brake myCar.Driver.power myCar.Driver.decreaseSpeed myCar.Driver.increaseSpeed myCar.Driver.ignition myCar.Driver.curve_real_instance /end REF_CHARACTERISTIC
/end GROUP
/begin GROUP myCar.myCar "" ROOT /begin REF_CHARACTERISTIC myCar.myCar.g /end REF_CHARACTERISTIC /begin SUB_GROUP myCar.myCar.myVehicle /end SUB_GROUP /end GROUP
/begin GROUP myCar.myCar.myVehicle ""
 /begin REF_CHARACTERISTIC myCar.myCar.myVehicle.BrakeMomentum myCar.myCar.myVehicle.EngineMomentum myCar.myCar.myVehicle.AirFriction myCar.myCar.myVehicle.Landscape myCar.myCar.myVehicle.TrackSize /end REF_CHARACTERISTIC
 /begin REF_MEASUREMENT myCar.myCar.myVehicle.bearing myCar.myCar.myVehicle.dh myCar.myCar.myVehicle.dist myCar.myCar.myVehicle.ds myCar.myCar.myVehicle.h myCar.myCar.myVehicle.momentum myCar.myCar.myVehicle.v myCar.myCar.myVehicle.x myCar.myCar.myVehicle.y /end REF_MEASUREMENT
 /begin SUB_GROUP myCar.myCar.myVehicle.MyTurn_instance /end SUB_GROUP
/end GROUP
/begin GROUP myCar.myCar.myVehicle.MyTurn_instance "" /begin REF_CHARACTERISTIC myCar.myCar.myVehicle.MyTurn_instance.D /end REF_CHARACTERISTIC
 /begin REF_MEASUREMENT myCar.myCar.myVehicle.MyTurn_instance.bearing myCar.myCar.myVehicle.MyTurn_instance.dpi myCar.myCar.myVehicle.MyTurn_instance.pi myCar.myCar.myVehicle.MyTurn_instance.x myCar.myCar.myVehicle.MyTurn_instance.y /end REF_MEASUREMENT
/end GROUP
/begin GROUP resources.CarMessages "" ROOT
 /begin REF_MEASUREMENT resources.CarMessages.bearing resources.CarMessages.currentVehicleSpeed resources.CarMessages.steering resources.CarMessages.time resources.CarMessages.v_brake resources.CarMessages.v_power resources.CarMessages.x resources.CarMessages.y /end REF_MEASUREMENT
/end GROUP
/begin GROUP resources.DriverMessages "" ROOT
 /begin REF_MEASUREMENT resources.DriverMessages.accButton resources.DriverMessages.acc_state resources.DriverMessages.d_brake resources.DriverMessages.d_power resources.DriverMessages.decreaseSpeed resources.DriverMessages.ignition resources.DriverMessages.increaseSpeed resources.DriverMessages.selected_v /end REF_MEASUREMENT
/end GROUP
/begin GROUP tests.Test_Brake "" ROOT /begin REF_CHARACTERISTIC tests.Test_Brake.execute_brake_test /end REF_CHARACTERISTIC /begin REF_MEASUREMENT tests.Test_Brake.test_succeeded /end REF_MEASUREMENT
 /begin SUB_GROUP tests.Test_Brake.accelerateStopWatch tests.Test_Brake.EdgeRising_instance tests.Test_Brake.accOnStopwatch tests.Test_Brake.EdgeRising_instance_2 tests.Test_Brake.EdgeRising_instance_3 /end SUB_GROUP
/end GROUP
/begin GROUP tests.Test_Brake.EdgeRising_instance "EdgeRising detects a rising edge of the logical input signal."
 /begin REF_MEASUREMENT tests.Test_Brake.EdgeRising_instance.buffer tests.Test_Brake.EdgeRising_instance.oldSignal /end REF_MEASUREMENT
/end GROUP
/begin GROUP tests.Test_Brake.EdgeRising_instance_2 "EdgeRising detects a rising edge of the logical input signal."
 /begin REF_MEASUREMENT tests.Test_Brake.EdgeRising_instance_2.buffer tests.Test_Brake.EdgeRising_instance_2.oldSignal /end REF_MEASUREMENT
/end GROUP
/begin GROUP tests.Test_Brake.EdgeRising_instance_3 "EdgeRising detects a rising edge of the logical input signal."
 /begin REF_MEASUREMENT tests.Test_Brake.EdgeRising_instance_3.buffer tests.Test_Brake.EdgeRising_instance_3.oldSignal /end REF_MEASUREMENT
/end GROUP
/begin GROUP tests.Test_Brake.accOnStopwatch "StopWatch increments the time counter by one dT." /begin REF_MEASUREMENT tests.Test_Brake.accOnStopwatch.timeCounter /end REF_MEASUREMENT /end GROUP
/begin GROUP tests.Test_Brake.accelerateStopWatch "StopWatch increments the time counter by one dT." /begin REF_MEASUREMENT tests.Test_Brake.accelerateStopWatch.timeCounter /end REF_MEASUREMENT /end GROUP
/end MODULE
/end PROJECT
