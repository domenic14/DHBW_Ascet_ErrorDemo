ASAP2_VERSION 1 41
/begin PROJECT MyCCF_PC3_PC "Generated by ETAS from Project MyCCF_PC3_PC"
/begin HEADER "" VERSION "000" PROJECT_NO ASD /end HEADER
/begin MODULE MyCCF_PC3_PC "Generated by ETAS ASCET7 from Project: MyCCF_PC3_PC"
/begin IF_DATA E_TARGET
 /begin SOURCE "Task0" 3 /* period */ 100 QP_BLOB 1 /end SOURCE
 /begin TP_BLOB /* programm id */ 1082150569 /* target id */ 7 0 2 0 /end TP_BLOB
/end IF_DATA
/begin MOD_PAR "" VERSION "000" ADDR_EPK 0x0 EPK "" SUPPLIER "ETAS GmbH" CUSTOMER "xxx" CUSTOMER_NO "000" USER "xxx" PHONE_NO "000" ECU "PC" CPU_TYPE "PCx86" NO_OF_INTERFACES 1 /end MOD_PAR
/begin MOD_COMMON "Common definitions" BYTE_ORDER MSB_LAST ALIGNMENT_BYTE 1 ALIGNMENT_WORD 2 ALIGNMENT_LONG 4 ALIGNMENT_FLOAT32_IEEE 4 ALIGNMENT_FLOAT64_IEEE 8 /end MOD_COMMON
/begin CHARACTERISTIC myCar.myCar.g "" VALUE 0x4363A0 STANDARD_VALUE_R32 0.0 esdl_resources_a -3.4028234663852886E+38 3.4028234663852886E+38 /end CHARACTERISTIC
/begin CHARACTERISTIC myCar.myCar.myVehicle.BrakeMomentum "" CURVE 0x4363E0 STANDARD_CURVE_R32R32 0.0 esdl_resources_a -3.4028234663852886E+38 3.4028234663852886E+38
 /begin AXIS_DESCR STD_AXIS NO_INPUT_QUANTITY esdl_ident 6 -3.4028234663852886E+38 3.4028234663852886E+38 /end AXIS_DESCR
/end CHARACTERISTIC
/begin CHARACTERISTIC myCar.myCar.myVehicle.EngineMomentum "" MAP 0x436414 STANDARD_MAP_R32R32R32 0.0 esdl_resources_a -3.4028234663852886E+38 3.4028234663852886E+38
 /begin AXIS_DESCR STD_AXIS NO_INPUT_QUANTITY esdl_ident 6 -3.4028234663852886E+38 3.4028234663852886E+38 /end AXIS_DESCR
 /begin AXIS_DESCR STD_AXIS NO_INPUT_QUANTITY esdl_resources_kmh 6 -3.4028234663852886E+38 3.4028234663852886E+38 /end AXIS_DESCR
/end CHARACTERISTIC
/begin CHARACTERISTIC myCar.myCar.myVehicle.AirFriction "" CURVE 0x4363AC STANDARD_CURVE_R32R32 0.0 esdl_resources_a -3.4028234663852886E+38 3.4028234663852886E+38
 /begin AXIS_DESCR STD_AXIS NO_INPUT_QUANTITY esdl_resources_kmh 6 -3.4028234663852886E+38 3.4028234663852886E+38 /end AXIS_DESCR
/end CHARACTERISTIC
/begin CHARACTERISTIC myCar.myCar.myVehicle.Landscape "" CURVE 0x4364D8 STANDARD_CURVE_R32R32 0.0 esdl_resources_m -3.4028234663852886E+38 3.4028234663852886E+38
 /begin AXIS_DESCR STD_AXIS NO_INPUT_QUANTITY esdl_resources_m 128 -3.4028234663852886E+38 3.4028234663852886E+38 /end AXIS_DESCR
/end CHARACTERISTIC
/begin CHARACTERISTIC myCar.myCar.myVehicle.TrackSize "" VALUE 0x4363A4 STANDARD_VALUE_R32 0.0 esdl_resources_m -3.4028234663852886E+38 3.4028234663852886E+38 /end CHARACTERISTIC
/begin CHARACTERISTIC myCar.myCar.myVehicle.MyTurn_instance.D "" VALUE 0x4363A8 STANDARD_VALUE_R32 0.0 esdl_resources_m -3.4028234663852886E+38 3.4028234663852886E+38 /end CHARACTERISTIC
/begin CHARACTERISTIC myCar.Driver.pow "" VALUE 0x43634C STANDARD_VALUE_R32 0.0 esdl_ident -3.4028234663852886E+38 3.4028234663852886E+38 /end CHARACTERISTIC
/begin CHARACTERISTIC myCar.Driver.vsoll "" VALUE 0x436354 STANDARD_VALUE_R32 0.0 esdl_resources_kmh -3.4028234663852886E+38 3.4028234663852886E+38 /end CHARACTERISTIC
/begin CHARACTERISTIC myCar.Driver.driverBrakes "" VALUE 0x436348 STANDARD_VALUE_R32 0.0 esdl_ident -3.4028234663852886E+38 3.4028234663852886E+38 /end CHARACTERISTIC
/begin CHARACTERISTIC myCar.Driver.resettime "" VALUE 0x436350 STANDARD_VALUE_R32 0.0 esdl_ident -3.4028234663852886E+38 3.4028234663852886E+38 /end CHARACTERISTIC
/begin CHARACTERISTIC myCar.CCF.K "" VALUE 0x4362E0 STANDARD_VALUE_R32 0.0 esdl_ident -3.4028234663852886E+38 3.4028234663852886E+38 /end CHARACTERISTIC
/begin CHARACTERISTIC myCar.CCF.TV "" VALUE 0x4362E8 STANDARD_VALUE_R32 0.0 esdl_ident -3.4028234663852886E+38 3.4028234663852886E+38 /end CHARACTERISTIC
/begin CHARACTERISTIC myCar.CCF.TN "" VALUE 0x4362E4 STANDARD_VALUE_R32 0.0 esdl_ident -3.4028234663852886E+38 3.4028234663852886E+38 /end CHARACTERISTIC
/begin CHARACTERISTIC myCar.CCF.mn "" VALUE 0x4362EC STANDARD_VALUE_R32 0.0 esdl_ident -3.4028234663852886E+38 3.4028234663852886E+38 /end CHARACTERISTIC
/begin CHARACTERISTIC myCar.CCF.mx "" VALUE 0x4362F0 STANDARD_VALUE_R32 0.0 esdl_ident -3.4028234663852886E+38 3.4028234663852886E+38 /end CHARACTERISTIC
/begin CHARACTERISTIC myCar.CCF.TVI.dv "" VALUE 0x4362F8 STANDARD_VALUE_R32 0.0 esdl_resources_kmh -3.4028234663852886E+38 3.4028234663852886E+38 /end CHARACTERISTIC
/begin CHARACTERISTIC myCar.CCF.TVI.mn "" VALUE 0x4362FC STANDARD_VALUE_R32 0.0 esdl_resources_kmh -3.4028234663852886E+38 3.4028234663852886E+38 /end CHARACTERISTIC
/begin CHARACTERISTIC myCar.CCF.TVI.mx "" VALUE 0x436300 STANDARD_VALUE_R32 0.0 esdl_resources_kmh -3.4028234663852886E+38 3.4028234663852886E+38 /end CHARACTERISTIC
/begin CHARACTERISTIC myCar.CCF.BasicControl_instance.c "" VALUE 0x4362F4 STANDARD_VALUE_R32 0.0 esdl_ident -3.4028234663852886E+38 3.4028234663852886E+38 /end CHARACTERISTIC
/begin MEASUREMENT myCar.myCar.myVehicle.h "" FLOAT32_IEEE esdl_resources_m 1 100.0 -3.4028234663852886E+38 3.4028234663852886E+38 ECU_ADDRESS 0x436370 /end MEASUREMENT
/begin MEASUREMENT myCar.myCar.myVehicle.dh "" FLOAT32_IEEE esdl_resources_m 1 100.0 -3.4028234663852886E+38 3.4028234663852886E+38 ECU_ADDRESS 0x436364 /end MEASUREMENT
/begin MEASUREMENT myCar.myCar.myVehicle.ds "" FLOAT32_IEEE esdl_resources_m 1 100.0 -3.4028234663852886E+38 3.4028234663852886E+38 ECU_ADDRESS 0x43636C /end MEASUREMENT
/begin MEASUREMENT myCar.myCar.myVehicle.momentum "" FLOAT32_IEEE esdl_resources_a 1 100.0 -3.4028234663852886E+38 3.4028234663852886E+38 ECU_ADDRESS 0x436374 /end MEASUREMENT
/begin MEASUREMENT myCar.myCar.myVehicle.dist "" FLOAT32_IEEE esdl_resources_m 1 100.0 -3.4028234663852886E+38 3.4028234663852886E+38 ECU_ADDRESS 0x436368 /end MEASUREMENT
/begin MEASUREMENT myCar.myCar.myVehicle.v "" FLOAT32_IEEE esdl_resources_kmh 1 100.0 -3.4028234663852886E+38 3.4028234663852886E+38 ECU_ADDRESS 0x436378 /end MEASUREMENT
/begin MEASUREMENT myCar.myCar.myVehicle.x "" FLOAT32_IEEE esdl_resources_m 1 100.0 -3.4028234663852886E+38 3.4028234663852886E+38 ECU_ADDRESS 0x43637C /end MEASUREMENT
/begin MEASUREMENT myCar.myCar.myVehicle.y "" FLOAT32_IEEE esdl_resources_m 1 100.0 -3.4028234663852886E+38 3.4028234663852886E+38 ECU_ADDRESS 0x436380 /end MEASUREMENT
/begin MEASUREMENT myCar.myCar.myVehicle.bearing "" FLOAT32_IEEE esdl_ident 1 100.0 -3.4028234663852886E+38 3.4028234663852886E+38 ECU_ADDRESS 0x436360 /end MEASUREMENT
/begin MEASUREMENT myCar.myCar.myVehicle.MyTurn_instance.x "" FLOAT32_IEEE esdl_resources_m 1 100.0 -3.4028234663852886E+38 3.4028234663852886E+38 ECU_ADDRESS 0x436390 /end MEASUREMENT
/begin MEASUREMENT myCar.myCar.myVehicle.MyTurn_instance.y "" FLOAT32_IEEE esdl_resources_m 1 100.0 -3.4028234663852886E+38 3.4028234663852886E+38 ECU_ADDRESS 0x436394 /end MEASUREMENT
/begin MEASUREMENT myCar.myCar.myVehicle.MyTurn_instance.bearing "" FLOAT32_IEEE esdl_ident 1 100.0 -3.4028234663852886E+38 3.4028234663852886E+38 ECU_ADDRESS 0x436384 /end MEASUREMENT
/begin MEASUREMENT myCar.myCar.myVehicle.MyTurn_instance.dpi "" FLOAT32_IEEE esdl_ident 1 100.0 -3.4028234663852886E+38 3.4028234663852886E+38 ECU_ADDRESS 0x436388 /end MEASUREMENT
/begin MEASUREMENT myCar.myCar.myVehicle.MyTurn_instance.pi "" FLOAT32_IEEE esdl_ident 1 100.0 -3.4028234663852886E+38 3.4028234663852886E+38 ECU_ADDRESS 0x43638C /end MEASUREMENT
/begin MEASUREMENT resources.CarMessages.v "" UWORD esdl_f0_01_kmh 1 100.0 0.0 200.0 ECU_ADDRESS 0x455108 /end MEASUREMENT
/begin MEASUREMENT resources.CarMessages.power "" FLOAT32_IEEE esdl_ident 1 100.0 -3.4028234663852886E+38 3.4028234663852886E+38 ECU_ADDRESS 0x45511C /end MEASUREMENT
/begin MEASUREMENT resources.CarMessages.brake "" FLOAT32_IEEE esdl_ident 1 100.0 -3.4028234663852886E+38 3.4028234663852886E+38 ECU_ADDRESS 0x455120 /end MEASUREMENT
/begin MEASUREMENT resources.CarMessages.steering "" FLOAT32_IEEE esdl_ident 1 100.0 -3.4028234663852886E+38 3.4028234663852886E+38 ECU_ADDRESS 0x455118 /end MEASUREMENT
/begin MEASUREMENT resources.CarMessages.bearing "" FLOAT32_IEEE esdl_ident 1 100.0 -3.4028234663852886E+38 3.4028234663852886E+38 ECU_ADDRESS 0x455124 /end MEASUREMENT
/begin MEASUREMENT resources.CarMessages.x "" FLOAT32_IEEE esdl_resources_m 1 100.0 -3.4028234663852886E+38 3.4028234663852886E+38 ECU_ADDRESS 0x455110 /end MEASUREMENT
/begin MEASUREMENT resources.CarMessages.y "" FLOAT32_IEEE esdl_resources_m 1 100.0 -3.4028234663852886E+38 3.4028234663852886E+38 ECU_ADDRESS 0x45510C /end MEASUREMENT
/begin MEASUREMENT resources.CarMessages.time "" FLOAT32_IEEE esdl_resources_s 1 100.0 -3.4028234663852886E+38 3.4028234663852886E+38 ECU_ADDRESS 0x455114 /end MEASUREMENT
/begin MEASUREMENT myCar.Driver.EdgeRising_instance.buffer "" UBYTE esdl_ident 1 100.0 0 1 ECU_ADDRESS 0x436338 BIT_MASK 0x1 /end MEASUREMENT
/begin MEASUREMENT myCar.Driver.EdgeRising_instance.oldSignal "" UBYTE esdl_ident 1 100.0 0 1 ECU_ADDRESS 0x436339 BIT_MASK 0x1 /end MEASUREMENT
/begin MEASUREMENT myCar.Driver.S.timeCounter "" FLOAT64_IEEE esdl_ident 1 100.0 -1.7976931348623157E+308 1.7976931348623157E+308 ECU_ADDRESS 0x436340 /end MEASUREMENT
/begin MEASUREMENT myCar.Driver.DriverControl_instance.pow "" FLOAT32_IEEE esdl_ident 1 100.0 -3.4028234663852886E+38 3.4028234663852886E+38 ECU_ADDRESS 0x43632C /end MEASUREMENT
/begin MEASUREMENT myCar.Driver.DriverControl_instance.bra "" FLOAT32_IEEE esdl_ident 1 100.0 -3.4028234663852886E+38 3.4028234663852886E+38 ECU_ADDRESS 0x436320 /end MEASUREMENT
/begin MEASUREMENT myCar.Driver.DriverControl_instance.on "" UBYTE esdl_ident 1 100.0 0 1 ECU_ADDRESS 0x436335 BIT_MASK 0x1 /end MEASUREMENT
/begin MEASUREMENT myCar.Driver.DriverControl_instance.error "" UBYTE esdl_ident 1 100.0 0 1 ECU_ADDRESS 0x436334 BIT_MASK 0x1 /end MEASUREMENT
/begin MEASUREMENT myCar.Driver.DriverControl_instance.errtime "" FLOAT32_IEEE esdl_ident 1 100.0 -3.4028234663852886E+38 3.4028234663852886E+38 ECU_ADDRESS 0x436328 /end MEASUREMENT
/begin MEASUREMENT myCar.Driver.DriverControl_instance.v "" FLOAT32_IEEE esdl_ident 1 100.0 -3.4028234663852886E+38 3.4028234663852886E+38 ECU_ADDRESS 0x436330 /end MEASUREMENT
/begin MEASUREMENT myCar.Driver.DriverControl_instance.dv "" FLOAT32_IEEE esdl_ident 1 100.0 -3.4028234663852886E+38 3.4028234663852886E+38 ECU_ADDRESS 0x436324 /end MEASUREMENT
/begin MEASUREMENT resources.DriverMessages.brake "" FLOAT32_IEEE esdl_ident 1 100.0 -3.4028234663852886E+38 3.4028234663852886E+38 ECU_ADDRESS 0x455130 /end MEASUREMENT
/begin MEASUREMENT resources.DriverMessages.power "" FLOAT32_IEEE esdl_ident 1 100.0 -3.4028234663852886E+38 3.4028234663852886E+38 ECU_ADDRESS 0x45512C /end MEASUREMENT
/begin MEASUREMENT resources.DriverMessages.on "" UBYTE esdl_ident 1 100.0 0 1 ECU_ADDRESS 0x455128 BIT_MASK 0x1 /end MEASUREMENT
/begin MEASUREMENT resources.DriverMessages.display "" UBYTE esdl_ident 1 100.0 0 1 ECU_ADDRESS 0x45512A BIT_MASK 0x1 /end MEASUREMENT
/begin MEASUREMENT resources.DriverMessages.increment "" UBYTE esdl_ident 1 100.0 0 1 ECU_ADDRESS 0x455129 BIT_MASK 0x1 /end MEASUREMENT
/begin MEASUREMENT resources.DriverMessages.decrement "" UBYTE esdl_ident 1 100.0 0 1 ECU_ADDRESS 0x45512B BIT_MASK 0x1 /end MEASUREMENT
/begin MEASUREMENT myCar.CCF.vsoll "" FLOAT32_IEEE esdl_resources_kmh 1 100.0 -3.4028234663852886E+38 3.4028234663852886E+38 ECU_ADDRESS 0x436280 /end MEASUREMENT
/begin MEASUREMENT myCar.CCF.TVI.v "" FLOAT32_IEEE esdl_resources_kmh 1 100.0 -3.4028234663852886E+38 3.4028234663852886E+38 ECU_ADDRESS 0x4362C8 /end MEASUREMENT
/begin MEASUREMENT myCar.CCF.OnRising.buffer "" UBYTE esdl_ident 1 100.0 0 1 ECU_ADDRESS 0x4362A4 BIT_MASK 0x1 /end MEASUREMENT
/begin MEASUREMENT myCar.CCF.OnRising.oldSignal "" UBYTE esdl_ident 1 100.0 0 1 ECU_ADDRESS 0x4362A5 BIT_MASK 0x1 /end MEASUREMENT
/begin MEASUREMENT myCar.CCF.PID_instance.inOLD "" FLOAT64_IEEE esdl_ident 1 100.0 -1.7976931348623157E+308 1.7976931348623157E+308 ECU_ADDRESS 0x4362A8 /end MEASUREMENT
/begin MEASUREMENT myCar.CCF.PID_instance.memory1 "" FLOAT64_IEEE esdl_ident 1 100.0 -1.7976931348623157E+308 1.7976931348623157E+308 ECU_ADDRESS 0x4362B0 /end MEASUREMENT
/begin MEASUREMENT myCar.CCF.PID_instance.memory2 "" FLOAT64_IEEE esdl_ident 1 100.0 -1.7976931348623157E+308 1.7976931348623157E+308 ECU_ADDRESS 0x4362B8 /end MEASUREMENT
/begin MEASUREMENT myCar.CCF.IncRising.buffer "" UBYTE esdl_ident 1 100.0 0 1 ECU_ADDRESS 0x4362A2 BIT_MASK 0x1 /end MEASUREMENT
/begin MEASUREMENT myCar.CCF.IncRising.oldSignal "" UBYTE esdl_ident 1 100.0 0 1 ECU_ADDRESS 0x4362A3 BIT_MASK 0x1 /end MEASUREMENT
/begin MEASUREMENT myCar.CCF.DecRising.buffer "" UBYTE esdl_ident 1 100.0 0 1 ECU_ADDRESS 0x4362A0 BIT_MASK 0x1 /end MEASUREMENT
/begin MEASUREMENT myCar.CCF.DecRising.oldSignal "" UBYTE esdl_ident 1 100.0 0 1 ECU_ADDRESS 0x4362A1 BIT_MASK 0x1 /end MEASUREMENT
/begin MEASUREMENT myCar.CCF.SplitSignal_instance.plus "" FLOAT32_IEEE esdl_ident 1 100.0 -3.4028234663852886E+38 3.4028234663852886E+38 ECU_ADDRESS 0x4362C4 /end MEASUREMENT
/begin MEASUREMENT myCar.CCF.SplitSignal_instance.minus "" FLOAT32_IEEE esdl_ident 1 100.0 -3.4028234663852886E+38 3.4028234663852886E+38 ECU_ADDRESS 0x4362C0 /end MEASUREMENT
/begin MEASUREMENT myCar.CCF.CCFS.sm "" UBYTE esdl_myCar_CCFStateStatemachineStates 1 100.0 0 1 ECU_ADDRESS 0x43629E /end MEASUREMENT
/begin MEASUREMENT myCar.CCF.CCFS.pow "" FLOAT32_IEEE esdl_ident 1 100.0 -3.4028234663852886E+38 3.4028234663852886E+38 ECU_ADDRESS 0x436294 /end MEASUREMENT
/begin MEASUREMENT myCar.CCF.CCFS.bra "" FLOAT32_IEEE esdl_ident 1 100.0 -3.4028234663852886E+38 3.4028234663852886E+38 ECU_ADDRESS 0x43628C /end MEASUREMENT
/begin MEASUREMENT myCar.CCF.CCFS.pw "" FLOAT32_IEEE esdl_ident 1 100.0 -3.4028234663852886E+38 3.4028234663852886E+38 ECU_ADDRESS 0x436298 /end MEASUREMENT
/begin MEASUREMENT myCar.CCF.CCFS.br "" FLOAT32_IEEE esdl_ident 1 100.0 -3.4028234663852886E+38 3.4028234663852886E+38 ECU_ADDRESS 0x436288 /end MEASUREMENT
/begin MEASUREMENT myCar.CCF.CCFS.on "" UBYTE esdl_ident 1 100.0 0 1 ECU_ADDRESS 0x43629D BIT_MASK 0x1 /end MEASUREMENT
/begin MEASUREMENT myCar.CCF.CCFS.act "" UBYTE esdl_ident 1 100.0 0 1 ECU_ADDRESS 0x43629C BIT_MASK 0x1 /end MEASUREMENT
/begin MEASUREMENT myCar.CCF.CCFS.ctrl "" FLOAT32_IEEE esdl_ident 1 100.0 -3.4028234663852886E+38 3.4028234663852886E+38 ECU_ADDRESS 0x436290 /end MEASUREMENT
/begin MEASUREMENT myCar.CCF.BasicControl_instance.v "" FLOAT32_IEEE esdl_ident 1 100.0 -3.4028234663852886E+38 3.4028234663852886E+38 ECU_ADDRESS 0x436284 /end MEASUREMENT
/begin COMPU_METHOD esdl_resources_m "" RAT_FUNC "%12.4" "m" COEFFS 0 1 0 0 0 1 /end COMPU_METHOD
/begin COMPU_METHOD esdl_ident "" RAT_FUNC "%12.4" "" COEFFS 0 1 0 0 0 1 /end COMPU_METHOD
/begin COMPU_METHOD esdl_resources_a "" RAT_FUNC "%12.4" "a" COEFFS 0 1 0 0 0 1 /end COMPU_METHOD
/begin COMPU_METHOD esdl_resources_kmh "" RAT_FUNC "%12.4" "kmh" COEFFS 0 1 0 0 0 1 /end COMPU_METHOD
/begin COMPU_METHOD esdl_f0_01_kmh "" RAT_FUNC "%12.4" "kmh" COEFFS 0 100 0 0 0 1 /end COMPU_METHOD
/begin COMPU_METHOD esdl_resources_s "" RAT_FUNC "%12.4" "s" COEFFS 0 1 0 0 0 1 /end COMPU_METHOD
/begin COMPU_METHOD esdl_myCar_CCFStateStatemachineStates "" TAB_VERB "%12.4" "" /* compu_tab_ref */ COMPU_TAB_REF esdl_myCar_CCFStateStatemachineStates_vtab /end COMPU_METHOD
/begin COMPU_VTAB esdl_myCar_CCFStateStatemachineStates_vtab "" TAB_VERB /* number value pairs */ 2 /* value pair */ 0 "PassThrough" /* value pair */ 1 "Control" /* default value */ DEFAULT_VALUE "Error" /end COMPU_VTAB
/begin FUNCTION MyCCF_PC3_PC ""
 /begin SUB_FUNCTION myCar.myCar SystemLib.Miscellaneous.DeltaTimeService myCar.Driver myCar.CCF /end SUB_FUNCTION
/end FUNCTION
/begin FUNCTION myCar.myCar "" /begin DEF_CHARACTERISTIC myCar.myCar.g /end DEF_CHARACTERISTIC
 /begin IN_MEASUREMENT resources.CarMessages.brake resources.CarMessages.power resources.CarMessages.steering /end IN_MEASUREMENT
 /begin OUT_MEASUREMENT resources.CarMessages.bearing resources.CarMessages.v resources.CarMessages.x resources.CarMessages.y /end OUT_MEASUREMENT
 /begin SUB_FUNCTION myCar.myCar.myVehicle /end SUB_FUNCTION
/end FUNCTION
/begin FUNCTION myCar.myCar.myVehicle ""
 /begin DEF_CHARACTERISTIC myCar.myCar.myVehicle.BrakeMomentum myCar.myCar.myVehicle.EngineMomentum myCar.myCar.myVehicle.AirFriction myCar.myCar.myVehicle.Landscape myCar.myCar.myVehicle.TrackSize /end DEF_CHARACTERISTIC
 /begin LOC_MEASUREMENT myCar.myCar.myVehicle.bearing myCar.myCar.myVehicle.dh myCar.myCar.myVehicle.dist myCar.myCar.myVehicle.ds myCar.myCar.myVehicle.h myCar.myCar.myVehicle.momentum myCar.myCar.myVehicle.v myCar.myCar.myVehicle.x myCar.myCar.myVehicle.y /end LOC_MEASUREMENT
 /begin SUB_FUNCTION myCar.myCar.myVehicle.MyTurn_instance /end SUB_FUNCTION
/end FUNCTION
/begin FUNCTION myCar.myCar.myVehicle.MyTurn_instance "" /begin DEF_CHARACTERISTIC myCar.myCar.myVehicle.MyTurn_instance.D /end DEF_CHARACTERISTIC
 /begin LOC_MEASUREMENT myCar.myCar.myVehicle.MyTurn_instance.bearing myCar.myCar.myVehicle.MyTurn_instance.dpi myCar.myCar.myVehicle.MyTurn_instance.pi myCar.myCar.myVehicle.MyTurn_instance.x myCar.myCar.myVehicle.MyTurn_instance.y /end LOC_MEASUREMENT
 /begin SUB_FUNCTION myCar.myCar.myVehicle.MyTurn_instance.Lib /end SUB_FUNCTION
/end FUNCTION
/begin FUNCTION myCar.myCar.myVehicle.MyTurn_instance.Lib "" /end FUNCTION
/begin FUNCTION SystemLib.Miscellaneous.DeltaTimeService "Provides the delta time variable" /end FUNCTION
/begin FUNCTION myCar.Driver ""
 /begin DEF_CHARACTERISTIC myCar.Driver.pow myCar.Driver.vsoll myCar.Driver.driverBrakes myCar.Driver.resettime /end DEF_CHARACTERISTIC
 /begin IN_MEASUREMENT resources.CarMessages.v resources.DriverMessages.display /end IN_MEASUREMENT
 /begin OUT_MEASUREMENT resources.DriverMessages.brake resources.DriverMessages.on resources.DriverMessages.power /end OUT_MEASUREMENT
 /begin SUB_FUNCTION myCar.Driver.EdgeRising_instance myCar.Driver.S myCar.Driver.RightOpenInterval_instance myCar.Driver.DriverControl_instance /end SUB_FUNCTION
/end FUNCTION
/begin FUNCTION myCar.Driver.EdgeRising_instance ""
 /begin LOC_MEASUREMENT myCar.Driver.EdgeRising_instance.buffer myCar.Driver.EdgeRising_instance.oldSignal /end LOC_MEASUREMENT
/end FUNCTION
/begin FUNCTION myCar.Driver.S "" /begin LOC_MEASUREMENT myCar.Driver.S.timeCounter /end LOC_MEASUREMENT /end FUNCTION
/begin FUNCTION myCar.Driver.RightOpenInterval_instance "" /end FUNCTION
/begin FUNCTION myCar.Driver.DriverControl_instance ""
 /begin LOC_MEASUREMENT myCar.Driver.DriverControl_instance.bra myCar.Driver.DriverControl_instance.dv myCar.Driver.DriverControl_instance.error myCar.Driver.DriverControl_instance.errtime myCar.Driver.DriverControl_instance.on myCar.Driver.DriverControl_instance.pow myCar.Driver.DriverControl_instance.v /end LOC_MEASUREMENT
 /begin SUB_FUNCTION myCar.Driver.DriverControl_instance.roi /end SUB_FUNCTION
/end FUNCTION
/begin FUNCTION myCar.Driver.DriverControl_instance.roi "" /end FUNCTION
/begin FUNCTION myCar.CCF ""
 /begin DEF_CHARACTERISTIC myCar.CCF.K myCar.CCF.TV myCar.CCF.TN myCar.CCF.mn myCar.CCF.mx /end DEF_CHARACTERISTIC
 /begin IN_MEASUREMENT resources.CarMessages.v resources.DriverMessages.brake resources.DriverMessages.decrement resources.DriverMessages.increment resources.DriverMessages.on resources.DriverMessages.power /end IN_MEASUREMENT
 /begin OUT_MEASUREMENT resources.CarMessages.brake resources.CarMessages.power resources.DriverMessages.display /end OUT_MEASUREMENT
 /begin LOC_MEASUREMENT myCar.CCF.vsoll /end LOC_MEASUREMENT
 /begin SUB_FUNCTION myCar.CCF.TVI myCar.CCF.OnRising myCar.CCF.PID_instance myCar.CCF.IncRising myCar.CCF.DecRising myCar.CCF.GZ myCar.CCF.SplitSignal_instance myCar.CCF.CCFS myCar.CCF.Limiter_instance myCar.CCF.BasicControl_instance /end SUB_FUNCTION
/end FUNCTION
/begin FUNCTION myCar.CCF.TVI "" /begin DEF_CHARACTERISTIC myCar.CCF.TVI.dv myCar.CCF.TVI.mn myCar.CCF.TVI.mx /end DEF_CHARACTERISTIC /begin LOC_MEASUREMENT myCar.CCF.TVI.v /end LOC_MEASUREMENT /end FUNCTION
/begin FUNCTION myCar.CCF.OnRising "" /begin LOC_MEASUREMENT myCar.CCF.OnRising.buffer myCar.CCF.OnRising.oldSignal /end LOC_MEASUREMENT /end FUNCTION
/begin FUNCTION myCar.CCF.PID_instance ""
 /begin LOC_MEASUREMENT myCar.CCF.PID_instance.inOLD myCar.CCF.PID_instance.memory1 myCar.CCF.PID_instance.memory2 /end LOC_MEASUREMENT
/end FUNCTION
/begin FUNCTION myCar.CCF.IncRising "" /begin LOC_MEASUREMENT myCar.CCF.IncRising.buffer myCar.CCF.IncRising.oldSignal /end LOC_MEASUREMENT /end FUNCTION
/begin FUNCTION myCar.CCF.DecRising "" /begin LOC_MEASUREMENT myCar.CCF.DecRising.buffer myCar.CCF.DecRising.oldSignal /end LOC_MEASUREMENT /end FUNCTION
/begin FUNCTION myCar.CCF.GZ "" /end FUNCTION
/begin FUNCTION myCar.CCF.SplitSignal_instance ""
 /begin LOC_MEASUREMENT myCar.CCF.SplitSignal_instance.minus myCar.CCF.SplitSignal_instance.plus /end LOC_MEASUREMENT
 /begin SUB_FUNCTION myCar.CCF.SplitSignal_instance.GZ /end SUB_FUNCTION
/end FUNCTION
/begin FUNCTION myCar.CCF.SplitSignal_instance.GZ "" /end FUNCTION
/begin FUNCTION myCar.CCF.CCFS ""
 /begin LOC_MEASUREMENT myCar.CCF.CCFS.act myCar.CCF.CCFS.br myCar.CCF.CCFS.bra myCar.CCF.CCFS.ctrl myCar.CCF.CCFS.on myCar.CCF.CCFS.pow myCar.CCF.CCFS.pw myCar.CCF.CCFS.sm /end LOC_MEASUREMENT
/end FUNCTION
/begin FUNCTION myCar.CCF.Limiter_instance "" /end FUNCTION
/begin FUNCTION myCar.CCF.BasicControl_instance "" /begin DEF_CHARACTERISTIC myCar.CCF.BasicControl_instance.c /end DEF_CHARACTERISTIC /begin LOC_MEASUREMENT myCar.CCF.BasicControl_instance.v /end LOC_MEASUREMENT /end FUNCTION
/begin RECORD_LAYOUT STANDARD_VALUE_R32 FNC_VALUES 1 FLOAT32_IEEE COLUMN_DIR DIRECT /end RECORD_LAYOUT
/begin RECORD_LAYOUT STANDARD_CURVE_R32R32 /* axis size */ NO_AXIS_PTS_X 1 UWORD /* axis */ AXIS_PTS_X 2 FLOAT32_IEEE INDEX_INCR DIRECT FNC_VALUES 3 FLOAT32_IEEE COLUMN_DIR DIRECT /end RECORD_LAYOUT
/begin RECORD_LAYOUT STANDARD_MAP_R32R32R32 /* x axis size */ NO_AXIS_PTS_X 1 UWORD /* y axis size */ NO_AXIS_PTS_Y 2 UWORD /* x axis */ AXIS_PTS_X 3 FLOAT32_IEEE INDEX_INCR DIRECT /* y axis */ AXIS_PTS_Y 4 FLOAT32_IEEE INDEX_INCR DIRECT FNC_VALUES 5 FLOAT32_IEEE COLUMN_DIR DIRECT /end RECORD_LAYOUT
/begin GROUP MyCCF_PC3_PC "" ROOT
 /begin SUB_GROUP myCar.myCar resources.CarMessages SystemLib.Miscellaneous.DeltaTimeService myCar.Driver resources.DriverMessages myCar.CCF /end SUB_GROUP
/end GROUP
/begin GROUP myCar.myCar "" /begin REF_CHARACTERISTIC myCar.myCar.g /end REF_CHARACTERISTIC /begin SUB_GROUP myCar.myCar.myVehicle /end SUB_GROUP /end GROUP
/begin GROUP myCar.myCar.myVehicle ""
 /begin REF_CHARACTERISTIC myCar.myCar.myVehicle.BrakeMomentum myCar.myCar.myVehicle.EngineMomentum myCar.myCar.myVehicle.AirFriction myCar.myCar.myVehicle.Landscape myCar.myCar.myVehicle.TrackSize /end REF_CHARACTERISTIC
 /begin REF_MEASUREMENT myCar.myCar.myVehicle.bearing myCar.myCar.myVehicle.dh myCar.myCar.myVehicle.dist myCar.myCar.myVehicle.ds myCar.myCar.myVehicle.h myCar.myCar.myVehicle.momentum myCar.myCar.myVehicle.v myCar.myCar.myVehicle.x myCar.myCar.myVehicle.y /end REF_MEASUREMENT
 /begin SUB_GROUP myCar.myCar.myVehicle.MyTurn_instance /end SUB_GROUP
/end GROUP
/begin GROUP myCar.myCar.myVehicle.MyTurn_instance "" /begin REF_CHARACTERISTIC myCar.myCar.myVehicle.MyTurn_instance.D /end REF_CHARACTERISTIC
 /begin REF_MEASUREMENT myCar.myCar.myVehicle.MyTurn_instance.bearing myCar.myCar.myVehicle.MyTurn_instance.dpi myCar.myCar.myVehicle.MyTurn_instance.pi myCar.myCar.myVehicle.MyTurn_instance.x myCar.myCar.myVehicle.MyTurn_instance.y /end REF_MEASUREMENT
 /begin SUB_GROUP myCar.myCar.myVehicle.MyTurn_instance.Lib /end SUB_GROUP
/end GROUP
/begin GROUP myCar.myCar.myVehicle.MyTurn_instance.Lib "" /end GROUP
/begin GROUP resources.CarMessages ""
 /begin REF_MEASUREMENT resources.CarMessages.bearing resources.CarMessages.brake resources.CarMessages.power resources.CarMessages.steering resources.CarMessages.time resources.CarMessages.v resources.CarMessages.x resources.CarMessages.y /end REF_MEASUREMENT
/end GROUP
/begin GROUP SystemLib.Miscellaneous.DeltaTimeService "Provides the delta time variable" /end GROUP
/begin GROUP myCar.Driver ""
 /begin REF_CHARACTERISTIC myCar.Driver.pow myCar.Driver.vsoll myCar.Driver.driverBrakes myCar.Driver.resettime /end REF_CHARACTERISTIC
 /begin SUB_GROUP myCar.Driver.EdgeRising_instance myCar.Driver.S myCar.Driver.RightOpenInterval_instance myCar.Driver.DriverControl_instance /end SUB_GROUP
/end GROUP
/begin GROUP myCar.Driver.EdgeRising_instance ""
 /begin REF_MEASUREMENT myCar.Driver.EdgeRising_instance.buffer myCar.Driver.EdgeRising_instance.oldSignal /end REF_MEASUREMENT
/end GROUP
/begin GROUP myCar.Driver.S "" /begin REF_MEASUREMENT myCar.Driver.S.timeCounter /end REF_MEASUREMENT /end GROUP
/begin GROUP myCar.Driver.RightOpenInterval_instance "" /end GROUP
/begin GROUP myCar.Driver.DriverControl_instance ""
 /begin REF_MEASUREMENT myCar.Driver.DriverControl_instance.bra myCar.Driver.DriverControl_instance.dv myCar.Driver.DriverControl_instance.error myCar.Driver.DriverControl_instance.errtime myCar.Driver.DriverControl_instance.on myCar.Driver.DriverControl_instance.pow myCar.Driver.DriverControl_instance.v /end REF_MEASUREMENT
 /begin SUB_GROUP myCar.Driver.DriverControl_instance.roi /end SUB_GROUP
/end GROUP
/begin GROUP myCar.Driver.DriverControl_instance.roi "" /end GROUP
/begin GROUP resources.DriverMessages ""
 /begin REF_MEASUREMENT resources.DriverMessages.brake resources.DriverMessages.decrement resources.DriverMessages.display resources.DriverMessages.increment resources.DriverMessages.on resources.DriverMessages.power /end REF_MEASUREMENT
/end GROUP
/begin GROUP myCar.CCF ""
 /begin REF_CHARACTERISTIC myCar.CCF.K myCar.CCF.TV myCar.CCF.TN myCar.CCF.mn myCar.CCF.mx /end REF_CHARACTERISTIC
 /begin REF_MEASUREMENT myCar.CCF.vsoll /end REF_MEASUREMENT
 /begin SUB_GROUP myCar.CCF.TVI myCar.CCF.OnRising myCar.CCF.PID_instance myCar.CCF.IncRising myCar.CCF.DecRising myCar.CCF.GZ myCar.CCF.SplitSignal_instance myCar.CCF.CCFS myCar.CCF.Limiter_instance myCar.CCF.BasicControl_instance /end SUB_GROUP
/end GROUP
/begin GROUP myCar.CCF.TVI "" /begin REF_CHARACTERISTIC myCar.CCF.TVI.dv myCar.CCF.TVI.mn myCar.CCF.TVI.mx /end REF_CHARACTERISTIC /begin REF_MEASUREMENT myCar.CCF.TVI.v /end REF_MEASUREMENT /end GROUP
/begin GROUP myCar.CCF.OnRising "" /begin REF_MEASUREMENT myCar.CCF.OnRising.buffer myCar.CCF.OnRising.oldSignal /end REF_MEASUREMENT /end GROUP
/begin GROUP myCar.CCF.PID_instance ""
 /begin REF_MEASUREMENT myCar.CCF.PID_instance.inOLD myCar.CCF.PID_instance.memory1 myCar.CCF.PID_instance.memory2 /end REF_MEASUREMENT
/end GROUP
/begin GROUP myCar.CCF.IncRising "" /begin REF_MEASUREMENT myCar.CCF.IncRising.buffer myCar.CCF.IncRising.oldSignal /end REF_MEASUREMENT /end GROUP
/begin GROUP myCar.CCF.DecRising "" /begin REF_MEASUREMENT myCar.CCF.DecRising.buffer myCar.CCF.DecRising.oldSignal /end REF_MEASUREMENT /end GROUP
/begin GROUP myCar.CCF.GZ "" /end GROUP
/begin GROUP myCar.CCF.SplitSignal_instance ""
 /begin REF_MEASUREMENT myCar.CCF.SplitSignal_instance.minus myCar.CCF.SplitSignal_instance.plus /end REF_MEASUREMENT
 /begin SUB_GROUP myCar.CCF.SplitSignal_instance.GZ /end SUB_GROUP
/end GROUP
/begin GROUP myCar.CCF.SplitSignal_instance.GZ "" /end GROUP
/begin GROUP myCar.CCF.CCFS ""
 /begin REF_MEASUREMENT myCar.CCF.CCFS.act myCar.CCF.CCFS.br myCar.CCF.CCFS.bra myCar.CCF.CCFS.ctrl myCar.CCF.CCFS.on myCar.CCF.CCFS.pow myCar.CCF.CCFS.pw myCar.CCF.CCFS.sm /end REF_MEASUREMENT
/end GROUP
/begin GROUP myCar.CCF.Limiter_instance "" /end GROUP
/begin GROUP myCar.CCF.BasicControl_instance "" /begin REF_CHARACTERISTIC myCar.CCF.BasicControl_instance.c /end REF_CHARACTERISTIC /begin REF_MEASUREMENT myCar.CCF.BasicControl_instance.v /end REF_MEASUREMENT /end GROUP
/end MODULE
/end PROJECT
